## arch/riscv32/soc/riscv-privilege/spinalhdl/Kconfig.series
```kconfig
# Kconfig - RISCV32_SPINALHDL SOC implementation
#
#
# SPDX-License-Identifier: Apache-2.0
#

config SOC_SERIES_RISCV32_SPINALHDL
	bool "SPINALHDL SoC implementation"
	depends on RISCV32
	select SOC_FAMILY_RISCV_PRIVILEGE
	help
	Enable support for SPINALHDL SoC
```

## arch/riscv32/soc/riscv-privilege/spinalhdl/Kconfig.soc
```kconfig
# Kconfig - RISCV32_SPINALHDL SOC configuration options
#
#
# SPDX-License-Identifier: Apache-2.0
#

choice
prompt "SPINALHDL SOC implementation"
depends on SOC_SERIES_RISCV32_SPINALHDL

config SOC_RISCV32_SPINALHDL
	bool "SPINALHDL SoC implementation"
	select ATOMIC_OPERATIONS_C

endchoice
```

## arch/riscv64/Kconfig
```kconfig
#
# SPDX-License-Identifier: Apache-2.0
#

menu "RISCV64 Options"
	depends on RISCV64

config ARCH
	string
	default "riscv64"

config ARCH_DEFCONFIG
	string
	default "arch/riscv64/defconfig"

menu "RISCV64 Processor Options"

config INCLUDE_RESET_VECTOR
	bool "Include Reset vector"
	help
	  Include the reset vector stub that inits CPU and then jumps to __start

config RISCV_SOC_CONTEXT_SAVE
	bool "Enable SOC-based context saving in IRQ handler"
	help
	  Enable SOC-based context saving, for SOCS which require saving of
	  extra registers when entering an interrupt/exception

config RISCV_SOC_INTERRUPT_INIT
	bool "Enable SOC-based interrupt initialization"
	help
	  Enable SOC-based interrupt initialization
	  (call soc_interrupt_init, within _IntLibInit when enabled)

config RISCV_GENERIC_TOOLCHAIN
	bool "Compile using generic riscv64 toolchain"
	default y
	help
	  Compile using generic riscv64 toolchain.
	  Allow SOCs that have custom extended riscv ISA to still
	  compile with generic riscv64 toolchain.

config RISCV_HAS_CPU_IDLE
	bool "Does SOC has CPU IDLE instruction"
	help
	  Does SOC has CPU IDLE instruction

config GEN_ISR_TABLES
	default y

config GEN_IRQ_VECTOR_TABLE
	default n

endmenu

endmenu
```

## boards/riscv32/vexriscv_cpp_regression/Kconfig.board
```kconfig
config BOARD_VEXRISCV_CPP_REGRESSION
	bool "VexRiscv"
	depends on SOC_VEXRISCV_CPP_REGRESSION
```

## boards/riscv32/vexriscv_cpp_regression/Kconfig.defconfig
```kconfig
if BOARD_VEXRISCV_CPP_REGRESSION

config BOARD
	default "vexriscv_cpp_regression"

endif
```

## boards/riscv32/vexriscv_cpp_regression/vexriscv_cpp_regression_defconfig
```kconfig
CONFIG_RISCV32=y
CONFIG_SOC_SERIES_RISCV32_VEXRISCV=y
CONFIG_SOC_VEXRISCV_CPP_REGRESSION=y
CONFIG_BOARD_VEXRISCV_CPP_REGRESSION=y
CONFIG_CONSOLE=y
CONFIG_SERIAL=y
CONFIG_UART_VEXRISCV_CPP_REGRESSION=y
CONFIG_UART_CONSOLE=y
CONFIG_PLIC=n
CONFIG_RISCV_MACHINE_TIMER=y
CONFIG_GPIO=n
CONFIG_BOOT_BANNER=y
CONFIG_SYS_CLOCK_HW_CYCLES_PER_SEC=12000000
```

## boards/riscv32/vexriscv_incus_up5k_evn/Kconfig.board
```kconfig
config BOARD_VEXRISCV_INCUS_UP5K_EVN
	bool "Incus UP5K Evn"
	depends on SOC_VEXRISCV_INCUS_SOC
```

## boards/riscv32/vexriscv_incus_up5k_evn/vexriscv_incus_up5k_evn_defconfig
```kconfig
CONFIG_RISCV32=y
CONFIG_SOC_SERIES_RISCV32_VEXRISCV=y
CONFIG_SOC_VEXRISCV_INCUS_SOC=y
CONFIG_BOARD_VEXRISCV_INCUS_UP5K_EVN=y
CONFIG_SERIAL=y
CONFIG_CONSOLE=y
CONFIG_UART_CONSOLE=y
CONFIG_UART_SPINAL_LIB_COM=y
CONFIG_PLIC=y
CONFIG_RISCV_MACHINE_TIMER=y
CONFIG_BOOT_BANNER=y
CONFIG_SYS_CLOCK_HW_CYCLES_PER_SEC=12000000
```

## boards/riscv32/vexriscv_saxon_up5k_evn/Kconfig.board
```kconfig
config BOARD_VEXRISCV_SAXON_UP5K_EVN
	bool "VexRiscv"
	depends on SOC_VEXRISCV_SAXON_SOC
```

## boards/riscv32/vexriscv_saxon_up5k_evn/Kconfig.defconfig
```kconfig
if BOARD_VEXRISCV_SAXON_UP5K_EVN

config BOARD
	default "vexriscv_saxon_up5k_evn"

endif
```

## boards/riscv32/vexriscv_saxon_up5k_evn/vexriscv_saxon_up5k_evn_defconfig
```kconfig
CONFIG_RISCV32=y
CONFIG_SOC_SERIES_RISCV32_VEXRISCV=y
CONFIG_SOC_VEXRISCV_SAXON_SOC=y
CONFIG_BOARD_VEXRISCV_SAXON_UP5K_EVN=y
CONFIG_CONSOLE=y
CONFIG_SERIAL=y
CONFIG_UART_CONSOLE_ON_DEV_NAME="uart0"
CONFIG_UART_SPINAL_LIB_COM_UART_UARTCTRL=y
CONFIG_UART_CONSOLE=y
CONFIG_PLIC=n
CONFIG_RISCV_MACHINE_TIMER=y
CONFIG_GPIO=n
CONFIG_BOOT_BANNER=y
CONFIG_SYS_CLOCK_HW_CYCLES_PER_SEC=12000000
```

## boards/riscv64/kendryte_evb/Kconfig.board
```kconfig
config BOARD_KENDRYTE_EVB
	bool "Kendryte EVB target"
	depends on SOC_RISCV64_K210
	select HAS_DTS
```

## boards/riscv64/kendryte_evb/kendryte_evb_defconfig
```kconfig
CONFIG_RISCV64=y
CONFIG_SOC_SERIES_RISCV64_K210=y
CONFIG_SOC_RISCV64_K210=y
CONFIG_BOARD_KENDRYTE_EVB=y
CONFIG_CONSOLE=y
CONFIG_PRINTK=y
CONFIG_SERIAL=y
CONFIG_UART_KENDRYTE=y
CONFIG_UART_KENDRYTE_PORT_3=y
CONFIG_UART_CONSOLE=y
CONFIG_PLIC_KENDRYTE=y
CONFIG_RISCV_MACHINE_TIMER=y
CONFIG_BOOT_BANNER=y
CONFIG_GPIO=y
CONFIG_GPIO_KENDRYTE=y
CONFIG_GPIOHS_KENDRYTE=y
CONFIG_PINMUX=y
CONFIG_PINMUX_KENDRYTE=y
CONFIG_DMA=y
CONFIG_DMA_KENDRYTE=y
CONFIG_SPI=y
CONFIG_SPI_0=y
CONFIG_SPI_KENDRYTE=y

# Clock configuration
CONFIG_CLOCK_CONTROL=y
CONFIG_CLOCK_CONTROL_KENDRYTE=y
```

## boards/riscv64/riscv64_limacon_malleus/Kconfig.defconfig
```kconfig
if BOARD_RISCV_GNSS

config BOARD
        default riscv_gnss

config CONSOLE
	def_bool y

config UART_CONSOLE
	def_bool y

config UART_INTERRUPT_DRIVEN
	def_bool y

config CONSOLE_HANDLER_SHELL
	def_bool y

config STDOUT_CONSOLE
	def_bool y

endif # BOARD_RISCV_GNSS
```

## boards/riscv64/riscv_gnss/riscv_gnss_defconfig
```kconfig
CONFIG_RISCV64=y
CONFIG_SOC_RISCV_GNSS=y
CONFIG_BOARD_RISCV_GNSS=y
CONFIG_PRINTK=y
CONFIG_STDOUT_CONSOLE=y
CONFIG_ENABLE_SHELL=y
xCONFIG_KERNEL_DEBUG=y
CONFIG_CONSOLE=y
CONFIG_EARLY_CONSOLE=y
CONFIG_UART_INTERRUPT_DRIVEN=y
CONFIG_BOOT_BANNER=y
CONFIG_CONSOLE_HAS_DRIVER=y
CONFIG_CONSOLE_HANDLER=y
CONFIG_CONSOLE_HANDLER_SHELL=y
CONFIG_CONSOLE_HANDLER_SHELL_STACKSIZE=2000
CONFIG_UART_CONSOLE=y
CONFIG_UART_CONSOLE_ON_DEV_NAME="UART_0"
CONFIG_NUM_COOP_PRIORITIES=16
CONFIG_NUM_PREEMPT_PRIORITIES=15
CONFIG_ISR_STACK_SIZE=2048
CONFIG_PRIORITY_CEILING=0
CONFIG_NUM_IRQS=6
CONFIG_SYS_CLOCK_EXISTS=y
CONFIG_SYS_CLOCK_HW_CYCLES_PER_SEC=40000000
CONFIG_SYS_CLOCK_TICKS_PER_SEC=200
CONFIG_NANO_TIMEOUTS=y
CONFIG_SYSTEM_WORKQUEUE_STACK_SIZE=2048
CONFIG_SYSTEM_WORKQUEUE_PRIORITY=-1
CONFIG_OFFLOAD_WORKQUEUE_STACK_SIZE=2048
CONFIG_OFFLOAD_WORKQUEUE_PRIORITY=-1
CONFIG_KERNEL_EVENT_LOGGER_BUFFER_SIZE=128
CONFIG_MAIN_THREAD_PRIORITY=0
CONFIG_MAIN_STACK_SIZE=2048
CONFIG_IDLE_STACK_SIZE=1024
CONFIG_SYSTEM_CLOCK_INIT_PRIORITY=0
CONFIG_KERNEL_INIT_PRIORITY_DEFAULT=40
CONFIG_ERRNO=y
CONFIG_NUM_MBOX_ASYNC_MSGS=10
CONFIG_NUM_PIPE_ASYNC_MSGS=10
```

## drivers/clock_control/Kconfig.kendryte
```kconfig
# Kconfig - Clock controller driver configuration options

#
# SPDX-License-Identifier: Apache-2.0
#

menuconfig CLOCK_CONTROL_KENDRYTE
	bool "Kendryte Clock controller support"
	depends on SOC_SERIES_RISCV64_K210
	help
	 Enable support for the Kendryte clock driver.
```

## drivers/dma/Kconfig.kendryte
```kconfig
# Kconfig - DMA configuration options
#
# SPDX-License-Identifier: Apache-2.0
#

menuconfig DMA_KENDRYTE
	bool "Enable KENDRYTE DMA driver"
	depends on SOC_RISCV64_K210
	help
	  DMA driver for KENDRYTE SoCs.
```

## drivers/gpio/Kconfig.kendryte
```kconfig
#
# SPDX-License-Identifier: Apache-2.0
#

menuconfig GPIO_KENDRYTE
	bool "Kendryte K210 GPIO driver"
	depends on GPIO && SOC_RISCV64_K210
	select HAS_DTS_GPIO
	help
	  Enable driver for the Kendryte K210 GPIO controller.

	  Says n if not sure.

if GPIO_KENDRYTE

config GPIO_KENDRYTE_GPIO_NAME
	string "GPIO driver name"
	default "gpio"

endif # GPIO_KENDRYTE

menuconfig GPIOHS_KENDRYTE
	bool "Kendryte K210 GPIO HS driver"
	depends on GPIO && SOC_RISCV64_K210
	select HAS_DTS_GPIO
	help
	  Enable driver for the Kendryte K210 GPIO HS controller.

	  Says n if not sure.

if GPIOHS_KENDRYTE

config GPIOHS_KENDRYTE_GPIO_NAME
	string "GPIO HS driver name"
	default "gpiohs"

endif # GPIOHS_KENDRYTE
```

## drivers/gpio/Kconfig.spinal_lib_io
```kconfig
menuconfig GPIO_SPINAL_LIB_IO
	bool "SPINAL_LIB_IO GPIO driver"
	depends on GPIO
	select HAS_DTS_GPIO
	help
	  Enable driver for the SPINAL_LIB_IO GPIO controller.

	  Says n if not sure.

if GPIO_SPINAL_LIB_IO


	
endif 
```

## drivers/gpio/Kconfig.spinalhdl
```kconfig
#
# SPDX-License-Identifier: Apache-2.0
#

menuconfig GPIO_SPINALHDL
	bool "SPINALHDL SoC GPIO driver"
	depends on GPIO && SOC_RISCV32_SPINALHDL
	default n
	help
	  Enable driver for the SPINALHDL SoC GPIO controller.

	  Says n if not sure.

if GPIO_SPINALHDL

config GPIO_SPINALHDL_GPIO_NAME
	string "GPIO driver name"
	default "gpio0"

endif # GPIO_SPINALHDL
```

## drivers/i2s/Kconfig.kendryte
```kconfig
# Kconfig - Kendryte I2S configuration options
#
# SPDX-License-Identifier: Apache-2.0
#

menuconfig I2S_KENDRYTE
	bool "Kendryte I2S Driver"
	depends on I2S && SOC_RISCV64_K210
	select DMA
	help
	  Enable Inter Sound (I2S) bus driver for Kendryte K210.

if I2S_KENDRYTE

config I2S_KENDRYTE_TX_BLOCK_COUNT
	int "TX queue length"
	default 4
	help
	  The maximum number of blocks that can be accommodated in the Tx queue.

config I2S_KENDRYTE_0_NAME
	string "I2S 0 device name"
	default "I2S_0"

endif # I2S_KENDRYTE
```

## drivers/pinmux/Kconfig.kendryte
```kconfig
#
# SPDX-License-Identifier: Apache-2.0
#

menuconfig PINMUX_KENDRYTE
	bool "Kendryte pinmux driver"
	depends on PINMUX && SOC_SERIES_RISCV64_K210
	help
	  Enable driver for the Kendryte pinmux driver
```

## drivers/serial/Kconfig.gnss
```kconfig
menuconfig UART_RISCV_GNSS
	bool "RISC-V GNSS board UART driver"
	default y
	help
	Enable the UART driver, built in generic CPU designs generated from
	VHDL.
```
