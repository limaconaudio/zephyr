/*
 * Copyright (c) 2018 Linaro Limited
 *
 * SPDX-License-Identifier: Apache-2.0
 */

/dts-v1/;

#include <vexriscv_cpp_regression.dtsi>

/ {
	model = "VexRiscv cpp regression";
	compatible = "spinal,vexriscv";
	aliases {
	};

	chosen {
		zephyr,console = &uart0;
		zephyr,shell-uart = &uart0;
	};
};

&uart0 {
	status = "ok";
	current-speed = <115200>;
	clock-frequency = <12000000>;
};
