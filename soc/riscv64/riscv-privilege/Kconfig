## soc/riscv64/riscv-privilege/Kconfig
```kconfig
# Kconfig - configuration options for riscv SOCs supporting
#           the riscv privileged architecture specification
#
#
# SPDX-License-Identifier: Apache-2.0
#

config SOC_FAMILY_RISCV_PRIVILEGE
	bool
	# omit prompt to signify a "hidden" option

config SOC_FAMILY
	string
	default "riscv-privilege"
	depends on SOC_FAMILY_RISCV_PRIVILEGE

config RISCV_HAS_PLIC
	bool "Does the SOC provide support for a Platform Level Interrupt Controller"
	depends on SOC_FAMILY_RISCV_PRIVILEGE
	help
	  Does the SOC provide support for a Platform Level Interrupt Controller


source "soc/riscv64/riscv-privilege/*/Kconfig.soc"
```

## soc/riscv64/riscv-privilege/Kconfig.defconfig
```kconfig
# Kconfig - riscv SOC family supporting the riscv privileged architecture spec
#
# SPDX-License-Identifier: Apache-2.0
#
source "soc/riscv64/riscv-privilege/*/Kconfig.defconfig.series"
```

## soc/riscv64/riscv-privilege/Kconfig.soc
```kconfig
# Kconfig - riscv SOC series supporting the riscv privileged architecture spec
#
# SPDX-License-Identifier: Apache-2.0
#

source "soc/riscv64/riscv-privilege/*/Kconfig.series"
```

## soc/riscv64/riscv-privilege/k210/Kconfig.defconfig.series
```kconfig
if SOC_SERIES_RISCV64_K210

config SOC_SERIES
	string
	default "k210"

config SYS_CLOCK_HW_CYCLES_PER_SEC
	int
	default 32768

config RISCV_SOC_INTERRUPT_INIT
	bool
	default y

config RISCV_HAS_CPU_IDLE
        bool
        default y

config RISCV_HAS_PLIC
        bool
        default y

config NUM_IRQS
	int
	default 64

config XIP
	bool
	default n

config RISCV_ROM_BASE_ADDR
	hex
	default 0x88000000

config RISCV_ROM_SIZE
	hex
	default 0x20000

config RISCV_RAM_BASE_ADDR
	hex
	default	0x80000000

config RISCV_RAM_SIZE
	hex
	default 0x600000

endif # SOC_SERIES_RISCV64_K210
```

## soc/riscv64/riscv-privilege/k210/Kconfig.series
```kconfig
# Kconfig - RISCV64_K210 SOC implementation
#
# SPDX-License-Identifier: Apache-2.0
#

config SOC_SERIES_RISCV64_K210
	bool "K210 SOC implementation"
	depends on RISCV64
	select SOC_FAMILY_RISCV_PRIVILEGE
	select CLOCK_CONTROL_KENDRYTE if CLOCK_CONTROL
	help
	  Enable support for K210 SOC
```

## soc/riscv64/riscv-privilege/k210/Kconfig.soc
```kconfig
# Kconfig - RISCV64_K210 SOC configuration options
#
# SPDX-License-Identifier: Apache-2.0
#

choice
prompt "K210 SOC implementation"
depends on SOC_SERIES_RISCV64_K210

config SOC_RISCV64_K210
	bool "K210 SOC implementation"
	select ATOMIC_OPERATIONS_C

endchoice
```
