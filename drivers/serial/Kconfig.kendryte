## drivers/serial/Kconfig.kendryte
```kconfig
#
# SPDX-License-Identifier: Apache-2.0
#

menuconfig UART_KENDRYTE
	bool "Kendryte serial driver"
	depends on SOC_RISCV64_K210
	select SERIAL_HAS_DRIVER
	help
	  This option enables the Kendryte serial driver.

# ---------- Port 1 ----------

menuconfig UART_KENDRYTE_PORT_1
	bool "Enable KENDRYTE Port 1"
	depends on UART_KENDRYTE
	help
	  This tells the driver to configure the UART1 port at boot,.

# ---------- Port 2 ----------

menuconfig UART_KENDRYTE_PORT_2
	bool "Enable KENDRYTE Port 2"
	depends on UART_KENDRYTE
	help
	  This tells the driver to configure the UART2 port at boot.

# ---------- Port 3 ----------

menuconfig UART_KENDRYTE_PORT_3
	bool "Enable KENDRYTE Port 3"
	depends on UART_KENDRYTE
	help
	  This tells the driver to configure the UART3 port at boot.
```

## drivers/serial/Kconfig.spinal_lib_com
```kconfig
menuconfig UART_SPINAL_LIB_COM
	bool "vexriscv UART driver"
	select SERIAL_HAS_DRIVER
	help
	  Enable the vexriscv UART driver.
```

## drivers/serial/Kconfig.spinal_lib_com_uart_uartCtrl
```kconfig
menuconfig UART_SPINAL_LIB_COM_UART_UARTCTRL
	bool "vexriscv UART driver"
	select SERIAL_HAS_DRIVER
	help
	  Enable the vexriscv UART driver.
```

## drivers/serial/Kconfig.spinalhdl
```kconfig
# Kconfig.gotham - SPINALHDL SoC UART configuration option
#
#
# SPDX-License-Identifier: Apache-2.0
#

menuconfig UART_SPINALHDL
        bool "SPINALHDL SoC serial driver"
        depends on SOC_RISCV32_SPINALHDL
        default n
        select SERIAL_HAS_DRIVER
        help
          This option enables the SPINALHDL SoC serial driver.
```

## drivers/serial/Kconfig.vexriscv_cpp_regression
```kconfig
menuconfig UART_VEXRISCV_CPP_REGRESSION
	bool "vexriscv sim UART driver"
	select SERIAL_HAS_DRIVER
	help
	  Enable the vexriscv sim UART driver.
```

## drivers/spi/Kconfig.kendryte
```kconfig
# Kconfig - Kendryte SPI driver configuration options
#
# SPDX-License-Identifier: Apache-2.0
#

menuconfig SPI_KENDRYTE
	bool "Enable KENDRYTE SPI driver"
	depends on SPI && SOC_RISCV64_K210
	select HAS_DTS_SPI
	help
	  SPI driver for KENDRYTE SoCs.
```

## drivers/watchdog/Kconfig.kendryte
```kconfig
# Kconfig - Kendryte WDT support
#
# SPDX-License-Identifier: Apache-2.0

menuconfig WDT_KENDRYTE
	bool "Kendryte WDT driver"
	default y
	depends on SOC_RISCV64_K210
	select HAS_DTS_WDT
	help
	  Enable support for WDT timer in Kendryte SoCs.

menuconfig WDT_KENDRYTE_0
	bool "Enable Kendryte WDT 0"
	depends on WDT_KENDRYTE
	help
	  This tells the driver to enable WDT 0.

menuconfig WDT_KENDRYTE_1
	bool "Enable Kendryte WDT 1"
	depends on WDT_KENDRYTE
	help
	  This tells the driver to enable WDT 1.
```

## dts/bindings/clock/kendryte,sysctl.yaml
```yaml
#
# SPDX-License-Identifier: Apache-2.0
#
---
title: Kendryte Sysctl
version: 0.1

description: >
    This is a representation of the Kendryte Sysctl node

properties:
    compatible:
      type: string
      category: required
      description: compatible strings
      constraint: "kendryte,sysctl"
      generation: define

    reg:
      type: int
      description: mmio register space
      generation: define
      category: required

    label:
      type: string
      category: required
      description: Human readable string describing the device (used by Zephyr for API name)
      generation: define
...
```

## dts/bindings/dma/kendryte,dma.yaml
```yaml
#
# SPDX-License-Identifier: Apache-2.0
#
---
title: Kendryte DMA
version: 0.1

description: >
    This is a representation of the Kendryte DMA nodes

properties:
    compatible:
      type: string
      category: required
      description: compatible strings
      constraint: "kendryte,dma"
      generation: define

    reg:
      type: int
      description: mmio register space
      generation: define
      category: required

    label:
      type: string
      category: required
      description: Human readable string describing the device (used by Zephyr for API name)
      generation: define
...
```

## dts/bindings/gpio/kendryte,gpio.yaml
```yaml
#
# SPDX-License-Identifier: Apache-2.0
#
---
title: Kendryte GPIO
version: 0.1

description: >
    This is a representation of the Kendryte GPIO nodes

properties:
    compatible:
      type: string
      category: required
      description: compatible strings
      constraint: "kendryte,gpio"
      generation: define

    reg:
      type: int
      description: mmio register space
      generation: define
      category: required

cell_string: GPIO

"#cells":
  - pin
  - flags
...
```

## dts/bindings/gpio/kendryte,gpiohs.yaml
```yaml
#
# SPDX-License-Identifier: Apache-2.0
#
---
title: Kendryte GPIOHS
version: 0.1

description: >
    This is a representation of the Kendryte GPIOHS nodes

properties:
    compatible:
      type: string
      category: required
      description: compatible strings
      constraint: "kendryte,gpiohs"
      generation: define

    reg:
      type: int
      description: mmio register space
      generation: define
      category: required

cell_string: GPIO

"#cells":
  - pin
  - flags
...
```

## dts/bindings/gpio/spinal,lib.io.gpio.yaml
```yaml
#
# Copyright (c) 2018, SiFive Inc.
#
# SPDX-License-Identifier: Apache-2.0
#
---
title: Spinal GPIO
version: 0.1

description: >
    This is a representation of the Spinal GPIO nodes

properties:
    compatible:
      type: string
      category: required
      description: compatible strings
      constraint: "spinal,lib-io-gpio"
      generation: define

    reg:
      type: int
      description: mmio register space
      generation: define
      category: required

    interrupts:
      type: int
      generation: define
      category: required

cell_string: GPIO

"#cells":
  - pin
  - flags
...
```

## dts/bindings/gpio/spinalhdl,gpio0.yaml
```yaml
#
# SPDX-License-Identifier: Apache-2.0
#
---
title: SPINALHDL GPIO
id: spinalhdl,gpio0
version: 0.1

description: >
    This is a representation of the SPINALHDL GPIO nodes

properties:
    compatible:
      type: string
      category: required
      description: compatible strings
      constraint: "spinalhdl,gpio0"
      generation: define

    reg:
      type: int
      description: mmio register space
      generation: define
      category: required
...
```

## dts/bindings/i2s/kendryte-i2s.yaml
```yaml
#
# SPDX-License-Identifier: Apache-2.0
#
---
title: Kendryte I2S
version: 0.1

description: >
    This binding gives a base representation of the Kendryte I2S controller

inherits:
    !include i2s.yaml

properties:
    compatible:
      constraint: "kendryte,i2s"

    reg:
      type: array
      description: mmio register space
      generation: define
      category: required

    label:
      type: string
      category: required
      description: Human readable string describing the device (used by Zephyr for API name)
      generation: define

...
```

## dts/bindings/interrupt-controller/spinalhdl,plic0.yaml
```yaml
#
# SPDX-License-Identifier: Apache-2.0
#
---
title: SPINALHDL PLIC
id: spinalhdl,plic0
version: 0.1

description: >
    This binding describes the SPINALHDL Platform-Local Interrupt Controller

properties:
  compatible:
      category: required
      type: string
      description: compatible strings
      constraint: "spinalhdl,plic0"
      generation: define

  reg:
      category: required
      type: int
      description: mmio register space
      generation: define

base_label: PLIC

"#cells":
  - irq
...
```

## dts/bindings/serial/kendryte,uart.yaml
```yaml
#
# Copyright (c) 2018, SiFive Inc.
#
# SPDX-License-Identifier: Apache-2.0
#
---
title: KENDRYTE UART
id: kendryte,uart1
version: 0.1

description: >
    This binding gives a base representation of the KENDRYTE UART

inherits:
    !include uart.yaml

properties:
    compatible:
      type: string
      category: required
      description: compatible strings
      constraint: "kendryte,uart"
      generation: define

    reg:
      type: array
      description: mmio register space
      generation: define
      category: required

    interrupts:
      type: array
      category: required
      description: required interrupts
      generation: define

...
```

## dts/bindings/serial/spinal,lib-com-uart.yaml
```yaml
#
# Copyright (c) 2018 Linaro Limited
#
# SPDX-License-Identifier: Apache-2.0
#
---
title: Spinal UART
version: 0.1

description: >
    This binding gives a base representation of the SIFIVE UART

inherits:
    !include uart.yaml

properties:
    compatible:
      type: string
      category: required
      description: compatible strings
      constraint: "spinal,lib-com-uart"
      generation: define

    reg:
      type: array
      description: mmio register space
      generation: define
      category: required

    interrupts:
      type: array
      category: required
      description: required interrupts
      generation: define

...
```

## dts/bindings/serial/spinalhdl,uart0.yaml
```yaml
#
# SPDX-License-Identifier: Apache-2.0
#
---
title: SPINALHDL UART
id: spinalhdl,uart0
version: 0.1

description: >
    This binding gives a base representation of the SPIANLHDL UART

inherits:
    !include uart.yaml

properties:
    compatible:
      type: string
      category: required
      description: compatible strings
      constraint: "spinalhdl,uart0"
      generation: define

    reg:
      type: array
      description: mmio register space
      generation: define
      category: required
...
```

## dts/bindings/spi/kendryte,spi.yaml
```yaml
#
# SPDX-License-Identifier: Apache-2.0
#
---
title: Kendryte SPI driver
version: 0.1

description: >
    This is a representation of the Kendryte SPI

properties:
    compatible:
      type: string
      category: required
      description: compatible strings
      constraint: "kendryte,spi"
      generation: define

    reg:
      type: int
      description: mmio register space
      generation: define
      category: required

    label:
      type: string
      category: required
      description: Human readable string describing the device (used by Zephyr for API name)
      generation: define
```

## soc/riscv32/riscv-privilege/vexriscv/Kconfig.defconfig.series
```kconfig
if SOC_SERIES_RISCV32_VEXRISCV

config SOC_SERIES
	string
	default "vexriscv"

rsource "Kconfig.defconfig.vexriscv_incus_soc"
rsource "Kconfig.defconfig.vexriscv_saxon_soc"
rsource "Kconfig.defconfig.vexriscv_cpp_regression"

endif # SOC_SERIES_RISCV32_VEXRISCV
```

## soc/riscv32/riscv-privilege/vexriscv/Kconfig.defconfig.vexriscv_cpp_regression
```kconfig
if SOC_VEXRISCV_CPP_REGRESSION

config SOC
	string
	default "vexriscv_cpp_regression"

config RISCV_ARCH
	string
	default "rv32i"

config RISCV_ABI
	string
	default "ilp32"

config SYS_CLOCK_HW_CYCLES_PER_SEC
	int
	default 1000000

config RISCV_SOC_INTERRUPT_INIT
	bool
	default y

config RISCV_HAS_CPU_IDLE
	bool
	default n

config RISCV_HAS_PLIC
	bool
	default n

config NUM_IRQS
	int
	default 42

config XIP
	bool
	default n

config RISCV_ROM_BASE_ADDR
	hex
	default 0x90000000

config RISCV_ROM_SIZE
	hex
	default 0x10

config RISCV_RAM_BASE_ADDR
	hex
	default	0x80000000

config RISCV_RAM_SIZE
	hex
	default 0x40000


config RISCV_MTIME_BASE
	hex
	default 0xF00FFF40

config RISCV_MTIMECMP_BASE
	hex
	default 0xF00FFF48

config BUILD_OUTPUT_HEX
        default y

endif
```

## soc/riscv32/riscv-privilege/vexriscv/Kconfig.defconfig.vexriscv_incus_soc
```kconfig
if SOC_VEXRISCV_INCUS_SOC

config SOC
	string
	default "vexriscv_incus_soc"

config RISCV_ARCH
	string
	default "rv32i"

config RISCV_ABI
	string
	default "ilp32"

config RISCV_SOC_INTERRUPT_INIT
	bool
	default y

config RISCV_HAS_CPU_IDLE
	bool
	default n

config RISCV_HAS_PLIC
	bool
	default y

config NUM_IRQS
	int
	default 64

config XIP
	bool
	default y

config RISCV_ROM_BASE_ADDR
	hex
	default 0x20100000

config RISCV_ROM_SIZE
	hex
	default 0x00300000

config RISCV_RAM_BASE_ADDR
	hex
	default	0x80000000

config RISCV_RAM_SIZE
	hex
	default 0x00020000

config RISCV_MTIME_BASE
	hex
	default 0x10008000

config RISCV_MTIMECMP_BASE
	hex
	default 0x10008008

endif
```

## soc/riscv32/riscv-privilege/vexriscv/Kconfig.defconfig.vexriscv_saxon_soc
```kconfig
if SOC_VEXRISCV_SAXON_SOC

config SOC
	string
	default "vexriscv_saxon_soc"

config RISCV_ARCH
	string
	default "rv32i"

config RISCV_ABI
	string
	default "ilp32"

config RISCV_SOC_INTERRUPT_INIT
	bool
	default y

config RISCV_HAS_CPU_IDLE
	bool
	default n

config RISCV_HAS_PLIC
	bool
	default n

config NUM_IRQS
	int
	default 42

config XIP
	bool
	default y

config RISCV_ROM_BASE_ADDR
	hex
	default 0x01100000

config RISCV_ROM_SIZE
	hex
	default 0x00100000

config RISCV_RAM_BASE_ADDR
	hex
	default	0x80000000

config RISCV_RAM_SIZE
	hex
	default 0x00010000

config RISCV_MTIME_BASE
	hex
	default 0xF0008000

config RISCV_MTIMECMP_BASE
	hex
	default 0xF0008008

endif
```

## soc/riscv32/riscv-privilege/vexriscv/Kconfig.series
```kconfig
config SOC_SERIES_RISCV32_VEXRISCV
	bool "VexRiscv implementation"
	depends on RISCV32
	select SOC_FAMILY_RISCV_PRIVILEGE
	help
	Enable support for VexRiscv
```

## soc/riscv32/riscv-privilege/vexriscv/Kconfig.soc
```kconfig
choice
prompt "VexRiscv implementation"
depends on SOC_SERIES_RISCV32_VEXRISCV

config SOC_VEXRISCV_INCUS_SOC
	bool "VexRiscv based Incus SoC"
	select ATOMIC_OPERATIONS_C

config SOC_VEXRISCV_SAXON_SOC
	bool "VexRiscv SoC"
	select ATOMIC_OPERATIONS_C

config SOC_VEXRISCV_CPP_REGRESSION
	bool "VexRiscv SoC"
	select ATOMIC_OPERATIONS_C

endchoice
```
